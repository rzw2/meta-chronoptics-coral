## conf/layer.conf
```bitbake
# We have a conf and classes directory, add to BBPATH
BBPATH .= ":${LAYERDIR}"

# We have a packages directory, add to BBFILES
BBFILES += "${LAYERDIR}/recipes-*/*/*.bb \
            ${LAYERDIR}/recipes-*/*/*.bbappend"

BBFILE_COLLECTIONS += "chronoptics-coral"
BBFILE_PATTERN_chronoptics-coral := "^${LAYERDIR}/"
BBFILE_PRIORITY_chronoptics-coral = "10"
LAYERSERIES_COMPAT_chronoptics-coral = "dunfell"

LAYERDEPENDS_chronoptics-coral = "core freescale-layer clang-layer"
```
